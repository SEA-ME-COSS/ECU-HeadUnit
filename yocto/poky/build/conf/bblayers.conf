## yocto/poky/build/conf/bblayers.conf
```bitbake
# POKY_BBLAYERS_CONF_VERSION is increased each time build/conf/bblayers.conf
# changes incompatibly
POKY_BBLAYERS_CONF_VERSION = "2"

BBPATH = "${TOPDIR}"
BBFILES ?= ""

BBLAYERS ?= " \
  /home/seame-workstation06/SEAME-COSS/DES-Head-Unit/yocto/poky/meta \
  /home/seame-workstation06/SEAME-COSS/DES-Head-Unit/yocto/poky/meta-poky \
  /home/seame-workstation06/SEAME-COSS/DES-Head-Unit/yocto/poky/meta-yocto-bsp \
  /home/seame-workstation06/SEAME-COSS/DES-Head-Unit/yocto/poky/meta-raspberrypi \
  /home/seame-workstation06/SEAME-COSS/DES-Head-Unit/yocto/poky/meta-openembedded/meta-oe \
  /home/seame-workstation06/SEAME-COSS/DES-Head-Unit/yocto/poky/meta-openembedded/meta-python \
  /home/seame-workstation06/SEAME-COSS/DES-Head-Unit/yocto/poky/meta-openembedded/meta-multimedia \
  /home/seame-workstation06/SEAME-COSS/DES-Head-Unit/yocto/poky/meta-openembedded/meta-networking \
  /home/seame-workstation06/SEAME-COSS/DES-Head-Unit/yocto/poky/meta-openembedded/meta-perl \
  /home/seame-workstation06/SEAME-COSS/DES-Head-Unit/yocto/poky/meta-qt5 \
  /home/seame-workstation06/SEAME-COSS/DES-Head-Unit/yocto/poky/meta-dongdong \
  "
```

## yocto/poky/meta-dongdong/conf/layer.conf
```bitbake
# We have a conf and classes directory, add to BBPATH
BBPATH .= ":${LAYERDIR}"

# We have recipes-* directories, add to BBFILES
BBFILES += "${LAYERDIR}/recipes-*/*/*.bb \
            ${LAYERDIR}/recipes-*/*/*.bbappend"

BBFILE_COLLECTIONS += "meta-dongdong"
BBFILE_PATTERN_meta-dongdong = "^${LAYERDIR}/"
BBFILE_PRIORITY_meta-dongdong = "15"

LAYERDEPENDS_meta-dongdong = "core"
LAYERSERIES_COMPAT_meta-dongdong = "kirkstone"
```
